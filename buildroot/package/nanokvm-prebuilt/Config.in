## buildroot/package/nanokvm-prebuilt/Config.in
```kconfig
config BR2_PACKAGE_NANOKVM_PREBUILT
	bool "nanokvm-prebuilt"
	help
	  Downloads the official NanoKVM pre-compiled release tarball from
	  Sipeed's GitHub releases and installs it directly into /kvmapp/.

	  Includes: NanoKVM-Server binary, web UI, all Sophgo dl_lib .so
	  files, kvm_system, jpg_stream, and system init scripts.

	  Use this instead of nanokvm-sg200x + nanokvm-server to skip the
	  Go/React source build entirely. Switch to nanokvm-sg200x if you
	  need to build from source or patch the server.
```

## buildroot/package/nanokvm-server/Config.in
```kconfig
config BR2_PACKAGE_NANOKVM_SERVER
	bool "nanokvm-server"
	depends on BR2_PACKAGE_HOST_GO_TARGET_ARCH_SUPPORTS
	depends on BR2_PACKAGE_HOST_NODEJS_BIN_ARCH_SUPPORTS
	select BR2_PACKAGE_HOST_GO
	select BR2_PACKAGE_HOST_NODEJS
	select BR2_PACKAGE_HOST_NODEJS_COREPACK
	select BR2_PACKAGE_HOST_PYTHON3
	select BR2_PACKAGE_PYTHON3_SSL
	help
	  NanoKVM server (Go backend + React web UI).
	  Builds NanoKVM-Server binary and web assets from source.
	  Requires RISC-V musl toolchain and middleware libraries.
```

## buildroot/package/nanokvm-sg200x/Config.in
```kconfig
config BR2_PACKAGE_NANOKVM_SG200X
	bool "nanokvm-sg200x"
	select BR2_PACKAGE_NANOKVM_SERVER
	help
	  NanoKVM application bundle for SG200x hardware.
	  Downloads the pre-assembled skeleton (init scripts, kvm_system
	  stubs, sensor configs) and installs the NanoKVM-Server binary
	  and web assets built by nanokvm-server into /kvmapp/.
```
